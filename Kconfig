## Kconfig
```kconfig
#
# Copyright (c) 2022 Laird Connectivity LLC
#
# SPDX-License-Identifier: LicenseRef-LairdConnectivity-Clause
#
menuconfig LCZ_LWM2M_BATTERY
	bool "Enable LwM2M BATTERY Object"
	depends on LCZ_LWM2M_UTIL
	depends on LWM2M_UCIFI_BATTERY

if LCZ_LWM2M_BATTERY

module=LCZ_LWM2M_BATTERY
module-str=LWM2M_BATTERY
source "subsys/logging/Kconfig.template.log_config"

endif # LCZ_LWM2M_BATTERY
```
